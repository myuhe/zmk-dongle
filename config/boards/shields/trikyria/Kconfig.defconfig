## config/boards/shields/trikyria/Kconfig.defconfig
```kconfig
if SHIELD_TRIKYRIA_DONGLE || SHIELD_TRIKYRIA_DONGLE_OLED

config ZMK_KEYBOARD_NAME
    default "Dongled Kyria"

config ZMK_SPLIT_ROLE_CENTRAL
    default y

config ZMK_USB
    default y

endif

if SHIELD_TRIKYRIA_LEFT || SHIELD_TRIKYRIA_RIGHT || SHIELD_TRIKYRIA_DONGLE || SHIELD_TRIKYRIA_DONGLE_OLED

config ZMK_SPLIT
    default y

config ZMK_BLE
    default y

	if ZMK_DISPLAY
	
		config ZMK_DISPLAY
		    select LV_USE_CONT
		    select LV_FONT_MONTSERRAT_26
		    select LV_FONT_MONTSERRAT_16
		    select LV_USE_LABEL
		    select LV_USE_IMG
		
		config I2C
			default y
		

	endif # ZMK_DISPLAY


endif
```
